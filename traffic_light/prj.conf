## CMakeLists.txt
```
cmake_minimum_required(VERSION 3.20.0)
find_package(Zephyr REQUIRED HINTS $ENV{ZEPHYR_BASE})

project(traffic_light)

target_sources(app PRIVATE 
    src/main.c
    src/TimeParser.h
    src/TimeParser.cpp)
```

## prj.conf
```kconfig
CONFIG_HEAP_MEM_POOL_SIZE=1024
CONFIG_TIMING_FUNCTIONS=y
```

## src/main.c
```c
// ##############################################################################################################
// Week 5 assignment currently finished for 2 points total
// ##############################################################################################################

#include <zephyr/kernel.h>
#include <zephyr/device.h>
#include <zephyr/drivers/gpio.h>
#include <zephyr/sys/util.h>
#include <zephyr/sys/printk.h>
#include <inttypes.h>
#include <zephyr/drivers/uart.h>
#include <string.h>
#include <ctype.h>
#include <zephyr/timing/timing.h>
#include "timeparser.h"




// Global variables
int led_state = 0;                      // 0 = red, 1 = yellow, 2 = green, 3 = pause
int prev_led_state = 0;                 // store previous state when pausing
int led_direction = 1;                  // 1 = forward, -1 = backward
enum { AUTO, MANUAL } mode = AUTO;      // operation mode, MANUAL(through UART input) or AUTO
static char custom_seq[20];
static int seq_index = 0;
static int seq_len = 0;
uint64_t red_timing_ns = 0;
uint64_t yellow_timing_ns = 0;
uint64_t green_timing_ns = 0;
bool red_done = false;
bool yellow_done = false;
bool green_done = false;

// Led pin configurations
static const struct gpio_dt_spec red   = GPIO_DT_SPEC_GET(DT_ALIAS(led0), gpios);
static const struct gpio_dt_spec green = GPIO_DT_SPEC_GET(DT_ALIAS(led1), gpios);

// Thread initializations
#define STACKSIZE 500
#define PRIORITY 5
void red_led_task(void *, void *, void*);
void yellow_led_task(void *, void *, void*);
void green_led_task(void *, void *, void*);

// Dispatcher FIFO
K_FIFO_DEFINE(dispatcher_fifo);

// Configure buttons
#define BUTTON_2 DT_ALIAS(sw2)
static const struct gpio_dt_spec BUTTON_2 = GPIO_DT_SPEC_GET_OR(BUTTON_2, gpios, {0});
static struct gpio_callback BUTTON_2_data;

// Button interrupt handler
void BUTTON_2_handler(const struct device *dev, struct gpio_callback *cb, uint32_t pins)
{
    if (led_state != 3) {
        prev_led_state = led_state;
        led_state = 3;
        printk("Button pressed, pausing sequence\n");
    } else {
        led_state = prev_led_state;
        printk("Button pressed, resuming sequence\n");
    }
}

// Button initialization
int init_button() {
    int ret;
    if (!gpio_is_ready_dt(&BUTTON_2)) {
        printk("Error: button not ready\n");
        return -1;
    }

    ret = gpio_pin_configure_dt(&BUTTON_2, GPIO_INPUT);
    if (ret != 0) return -1;

    ret = gpio_pin_interrupt_configure_dt(&BUTTON_2, GPIO_INT_EDGE_TO_ACTIVE);
    if (ret != 0) return -1;

    gpio_init_callback(&BUTTON_2_data, BUTTON_2_handler, BIT(BUTTON_2.pin));
    gpio_add_callback(BUTTON_2.port, &BUTTON_2_data);
    printk("Button initialized\n");
    return 0;
}

// Initialize leds
int init_led() {
    if (gpio_pin_configure_dt(&red, GPIO_OUTPUT_ACTIVE) < 0) return -1;
    if (gpio_pin_configure_dt(&green, GPIO_OUTPUT_ACTIVE) < 0) return -1;

    gpio_pin_set_dt(&red, 0);
    gpio_pin_set_dt(&green, 0);

    printk("LEDs initialized\n");
    return 0;
}

// Red LED one-shot timer handler
void red_timer_handler(struct k_timer *timer_id) {
    gpio_pin_set_dt(&red, 0);  // turn off red LED
    printk("Red LED OFF\n");
}

// Declare the timer
K_TIMER_DEFINE(red_timer, red_timer_handler, NULL);

// Timer handler that starts the red LED for 3 seconds
void action_delay_handler(struct k_timer *timer_id) {
    printk("Time reached! Turning red LED ON for 3 seconds.\n");
    gpio_pin_set_dt(&red, 1);
    gpio_pin_set_dt(&green, 0);

    // Start the 3-second red timer
    k_timer_start(&red_timer, K_SECONDS(3), K_NO_WAIT);
}

// Declare the delay timer
K_TIMER_DEFINE(action_delay_timer, action_delay_handler, NULL);


// This runs when the timer expires
void action_timer_handler(struct k_timer *timer_id) {
    printk("Timer expired! Turning on red light for 3 seconds...\n");

    gpio_pin_set_dt(&red, 1);
    gpio_pin_set_dt(&green, 0);

    k_msleep(3000);  // keep red on for 3 seconds

    gpio_pin_set_dt(&red, 0);
    printk("Red light off\n");
}

K_TIMER_DEFINE(action_timer, action_timer_handler, NULL);  // Declare timer

// UART initialization
#define UART_DEVICE_NODE DT_CHOSEN(zephyr_shell_uart)
static const struct device *const uart_dev = DEVICE_DT_GET(UART_DEVICE_NODE);

int init_uart(void) {
    if (!device_is_ready(uart_dev)) return 1;
    return 0;
}

// Data in FIFO
struct data_t {
    void *fifo_reserved;
    char msg[20];
};

// LED Tasks
// Red LED
void red_led_task(void *, void *, void*) {
    printk("Red LED thread started\n");

    timing_start();

    while (true) {
        if (led_state == 3) { k_msleep(50); continue; }

        // Manual mode
        if (mode == MANUAL) {
            if (seq_index < seq_len && custom_seq[seq_index] == 'R') {
                gpio_pin_set_dt(&red, 1);
                gpio_pin_set_dt(&green, 0);

                printk("Red LED ON\n");

                k_msleep(1000);
                seq_index++;
                if (seq_index >= seq_len) mode = AUTO;
            }
            k_msleep(50);
            continue;
        }

        // AUTO sequence
        if (led_state == 0) {
            timing_t red_start_time = timing_counter_get();

            gpio_pin_set_dt(&red, 1);
            gpio_pin_set_dt(&green, 0);
            red_done = true;
            //printk("RED ON\n");

            for (int i = 0; i < 100; i++) {
                if (led_state == 3) break;
                k_msleep(10);
                k_yield();
            }
            if (led_state != 3) {
                led_direction = 1;
                led_state = 1;
            }

            timing_t red_end_time = timing_counter_get();
            //timing_stop();
            red_timing_ns = timing_cycles_to_ns(timing_cycles_get(&red_start_time, &red_end_time));
            //printk("Red task: %lld microseconds\n", red_timing_ns / 1000);
        }

        k_msleep(50);
    }
}

// Yellow LED
void yellow_led_task(void *, void *, void*) {
    printk("Yellow LED thread started\n");

    timing_start();

    while (true) {
        if (led_state == 3) { k_msleep(50); continue; }

        // Manual mode
        if (mode == MANUAL) {
            if (seq_index < seq_len && custom_seq[seq_index] == 'Y') {
                gpio_pin_set_dt(&red, 1);
                gpio_pin_set_dt(&green, 1);

                printk("Yellow LED ON\n");

                k_msleep(1000);
                seq_index++;
                if (seq_index >= seq_len) mode = AUTO;
            }
            k_msleep(50);
            continue;
        }

        // AUTO sequence
        if (led_state == 1) {
            timing_t yellow_start_time = timing_counter_get();

            gpio_pin_set_dt(&red, 1);
            gpio_pin_set_dt(&green, 1);
            yellow_done = true;
            //printk("YELLOW ON\n");

            for (int i = 0; i < 100; i++) {
                if (led_state == 3) break;
                k_msleep(10);
                k_yield();
            }
            if (led_state != 3) {
                if (led_direction == 1)
                    led_state = 2;
                else
                    led_state = 0;
            }

            timing_t yellow_end_time = timing_counter_get();
            //timing_stop();
            yellow_timing_ns = timing_cycles_to_ns(timing_cycles_get(&yellow_start_time, &yellow_end_time));
            //printk("Yellow task: %lld microseconds\n", yellow_timing_ns / 1000);
        }

        k_msleep(50);
    }
}

// Green LED
void green_led_task(void *, void *, void*) {
    printk("Green LED thread started\n");

    timing_start();

    while (true) {
        if (led_state == 3) { k_msleep(50); continue; }

        // Manual mode
        if (mode == MANUAL) {
            if (seq_index < seq_len && custom_seq[seq_index] == 'G') {
                gpio_pin_set_dt(&red, 0);
                gpio_pin_set_dt(&green, 1);

                printk("Green LED ON\n");

                k_msleep(1000);
                seq_index++;
                if (seq_index >= seq_len) mode = AUTO;
            }
            k_msleep(50);
            continue;
        }

        // AUTO sequence
        if (led_state == 2) {
            timing_t green_start_time = timing_counter_get();

            gpio_pin_set_dt(&red, 0);
            gpio_pin_set_dt(&green, 1);
            green_done = true;
            // printk("GREEN ON\n");

            for (int i = 0; i < 100; i++) {
                if (led_state == 3) break;
                k_msleep(10);
                k_yield();
            }
            if (led_state != 3) {
                led_direction = -1;
                led_state = 1;
            }

            timing_t green_end_time = timing_counter_get();
            //timing_stop();
            green_timing_ns = timing_cycles_to_ns(timing_cycles_get(&green_start_time, &green_end_time));
            //printk("Green task: %lld microseconds\n", green_timing_ns / 1000);
        }

        k_msleep(50);
    }
}

// void timing_monitor_task(void *, void *, void*) {
//     while (true) {
//         // Only calculate when R, Y, G have finished
//         if (red_done && yellow_done && green_done) {
//             uint64_t total_ns = red_timing_ns + yellow_timing_ns + green_timing_ns;
            
//             printk("====================================\n");
//             printk("======= WITHOUT DEBUG PRINTS =======\n");
//             printk("====================================\n");
//             printk("Red task: %lld microseconds\n", red_timing_ns / 1000);
//             printk("Yellow task: %lld microseconds\n", yellow_timing_ns / 1000);
//             printk("Green task: %lld microseconds\n", green_timing_ns / 1000);
//             printk("Total R->Y->G sequence time: %lld microseconds\n", total_ns / 1000);
//             printk("====================================\n");
//             printk("====================================\n");

//             // Reset flags for the next R->Y->G cycle
//             red_done = false;
//             yellow_done = false;
//             green_done = false;
//         }
//         k_msleep(10); // avoid busy wait
//     }
// }



// UART Task
static void uart_task(void *unused1, void *unused2, void *unused3)
{
    char rc = 0;
    char uart_msg[20];
    memset(uart_msg, 0, sizeof(uart_msg));
    int uart_msg_cnt = 0;

    while (true) {
        if (uart_poll_in(uart_dev, &rc) == 0) {
            rc = toupper((unsigned char)rc);
            if (rc != '\r' && uart_msg_cnt < sizeof(uart_msg)-1) {
                uart_msg[uart_msg_cnt++] = rc;
            } else if (uart_msg_cnt > 0) {
                uart_msg[uart_msg_cnt] = '\0';

                struct data_t *buf = k_malloc(sizeof(struct data_t));
                if (buf) {
                    strncpy(buf->msg, uart_msg, sizeof(buf->msg)-1);
                    buf->msg[sizeof(buf->msg)-1] = '\0';
                    k_fifo_put(&dispatcher_fifo, buf);
                }

                uart_msg_cnt = 0;
                memset(uart_msg, 0, sizeof(uart_msg));
            }
        }
        k_msleep(10);
    }
}



static void dispatcher_task(void *unused1, void *unused2, void *unused3)
{
    while (true) {
        struct data_t *rec_item = k_fifo_get(&dispatcher_fifo, K_FOREVER);

        char custom_seq[20];
        strncpy(custom_seq, rec_item->msg, sizeof(custom_seq)-1);
        custom_seq[sizeof(custom_seq)-1] = '\0';

        printk("Dispatcher received: %s\n", custom_seq);

        // Accept HHMMSS format
        if (strlen(custom_seq) == 6) {
            int parsed_time = time_parse(custom_seq);

            if (parsed_time >= 0) {
                printk("Parsed time: %d seconds. Red LED will turn on after this delay.\n", parsed_time);

                // Schedule red LED after parsed_time seconds
                k_timer_start(&action_delay_timer, K_SECONDS(parsed_time), K_NO_WAIT);
            } else {
                printk("Invalid time input!\n");
            }
        } else {
            printk("Invalid command. Expected HHMMSS format, e.g., 000005\n");
        }

        k_free(rec_item);
    }
}



// Main
int main(void)
{
    init_led();
    init_button();
    timing_init();

    if (init_uart() != 0) {
        printk("UART initialization failed!\n");
        return -1;
    }

    // Wait for everything to initialize and threads to start
    k_msleep(100);
    printk("Traffic light started. Type sequence via UART to override.\n");
    return 0;
}

// Threads
K_THREAD_DEFINE(uart_thread, STACKSIZE, uart_task, NULL, NULL, NULL, PRIORITY, 0, 0);
K_THREAD_DEFINE(dis_thread, STACKSIZE, dispatcher_task, NULL, NULL, NULL, PRIORITY, 0, 0);
K_THREAD_DEFINE(red_thread, STACKSIZE, red_led_task, NULL, NULL, NULL, PRIORITY, 0, 0);
K_THREAD_DEFINE(yellow_thread, STACKSIZE, yellow_led_task, NULL, NULL, NULL, PRIORITY, 0, 0);
K_THREAD_DEFINE(green_thread, STACKSIZE, green_led_task, NULL, NULL, NULL, PRIORITY, 0, 0);
// K_THREAD_DEFINE(monitor_thread, STACKSIZE, timing_monitor_task, NULL, NULL, NULL, PRIORITY, 0, 0);
```

## src/TimeParser.cpp
```c
#include <stdlib.h>
#include <string.h>
#include <ctype.h>
#include "timeparser.h"

// time format: HHMMSS (6 characters)
int time_parse(char *time) {
    // Check that the pointer is not NULL
    if (time == NULL) {
        return TIME_ARRAY_ERROR;
    }

    // Check that the string length is 6
    if (strlen(time) != 6) {
        return TIME_LEN_ERROR; 
    }

    // Check that all characters are digits
    for (int i = 0; i < 6; i++) {
        if (!isdigit((unsigned char)time[i])) {
            return TIME_VALUE_ERROR;
        }
    }

    // Get hour, minute, and second parts
    char hh[3] = { time[0], time[1], '\0' };
    char mm[3] = { time[2], time[3], '\0' };
    char ss[3] = { time[4], time[5], '\0' };

    int hour = atoi(hh);
    int minute = atoi(mm);
    int second = atoi(ss);

    // Check that the values are within valid range
    if (hour < 0 || hour > 23) return TIME_VALUE_ERROR;
    if (minute < 0 || minute > 59) return TIME_VALUE_ERROR;
    if (second < 0 || second > 59) return TIME_VALUE_ERROR;

    // Calculate total seconds
    int total_seconds = hour * 3600 + minute * 60 + second;

    // Return the total seconds
    return total_seconds;
}
```

## src/TimeParser.h
```c
#ifndef TIMEPARSER_H
#define TIMEPARSER_H

// Error codes
#define TIME_LEN_ERROR      -1
#define TIME_ARRAY_ERROR    -2
#define TIME_VALUE_ERROR    -3

#ifdef __cplusplus
extern "C" {
#endif

int time_parse(char *time);

#ifdef __cplusplus
}
#endif

#endif
```
